/************************************************
文件：IIC.c
用途：TWI操作函数
************************************************/
#include "config.h"

/*************************************************************************
** 函数名称: twi_init(void)  bit rate:32
** 功能描述: i2c通信初始化
** 输　入  : 
** 输出	   : 
** 全局变量: 无
**************************************************************************/
void i2c_init(void)
{
	TWCR = 0x00; 			//disable twi
	TWBR = 0x20; 			//set bit rate 32
	TWSR = 0x00; 			//set prescale
	TWAR = 0x00; 			//set slave address
	TWCR = (1 << TWEN); 	//enable twi
}
/*************************************************************************
** 函数名称: i2cstart(void)
** 功能描述: i2c通信开始
** 输　入: 
** 输出	 : 
**************************************************************************/
void i2c_start(void)
{ 
	TWCR = (1 << TWINT) | (1 << TWSTA) | (1 << TWEN); 	//TWINT写1清0，中断标志位，TWSTA是让AVR成为主机，TWEN是使能TWI
	while (!(TWCR & (1 << TWINT)));					  	//等待TWI的TWINT置位，若置位表示START信号发送成功
}

/*************************************************************************
** 函数名称: uint8 i2cwt(uint8 data)
** 功能描述: i2c写数据,返回TWI状态
** 输　入  : 
** 输  出  : TWI状态

**************************************************************************/
uint8 i2c_write_byte(uint8 data)
{ 
	TWDR = data;										//data是要发送的数据，data可以是数据，也可以是地址
	TWCR = (1 << TWINT) | (1 << TWEN);					//清除TWINT标记（写1清0）并启动twi发送data
	while (!(TWCR & (1 << TWINT)));						//等待TWINT置位，一旦置位，表明data已成功发送，为保证正确可加入判断接收到的ACK
	_NOP();
	return (TWSR&0b11111000);							//返回ACK状态，低两位是TWI速率分频因子，而第三位为保留位
}

/*************************************************************************
** 函数名称:uint8 i2c_write_string(uint8 *data_buf)
** 功能描述: i2c停止
** 输　入  : 
** 输出	   : 
**************************************************************************/
uint8 i2c_write_string(uint8 *data_buf, uint8 len)
{
    uint8 *p_buf = (uint8 *)data_buf;

    for(; len > 0; len--)
    {
        TWDR = *p_buf;									//data是要发送的数据，data可以是数据，也可以是地址
	    TWCR = (1 << TWINT) | (1 << TWEN);				//清除TWINT标记（写1清0）并启动twi发送data
	    while (!(TWCR & (1 << TWINT)));					//等待TWINT置位，一旦置位，表明data已成功发送，为保证正确可加入判断接收到的ACK
	    _NOP();
	    p_buf++;
    }
    
    return (TWSR&0b11111000);
}

/*************************************************************************
** 函数名称: uint8 i2crd(void)
** 功能描述: i2c读数据
** 输　入  : 
** 输出	   : 读取的数据
**************************************************************************/
uint8 i2c_read_byte(void)								//读取数据
{
	TWCR= (1 << TWINT) | (1 << TWEA) | (1 << TWEN);		//清空TWINT，使能TWI应答，并使能TWI
	while (!(TWCR & (1 << TWINT)));						//等待TWINT置位，一旦置位，表明数据已接收完成
	return(TWDR);										//返回接收到的数据
}

/*************************************************************************
** 函数名称: void i2c_read_string(uint8 *receive, uint8 num)
** 功能描述: i2c读取字符串
** 输　入  : 
** 输出	   : 
**************************************************************************/
void i2c_read_string(uint8 *receive, uint8 len)
{
    uint8 *p_buf = (uint8 *)receive;
    
    for(; len > 2; len--)
    {
        TWCR= (1 << TWINT) | (1 << TWEN);	            //清空TWINT，并使能TWI
	    while (!(TWCR & (1 << TWINT)));					//等待TWINT置位，一旦置位，表明数据已接收完成
	    *p_buf = TWDR;
	    p_buf++;
    }
    
    *p_buf++ = i2c_read_byte();                         //使能应答
    
    TWCR= (1 << TWINT) | (1 << TWEN);	                //清空TWINT，并使能TWI
    while (!(TWCR & (1 << TWINT)));				   		//等待TWINT置位，一旦置位，表明数据已接收完成
	*p_buf = TWDR;     
}
/*************************************************************************
** 函数名称: i2c_stop(void)
** 功能描述: i2c停止
** 输　入  : 
** 输出	   : 
**************************************************************************/
void i2c_stop(void)										//TWI停止
{ 
	TWCR = (1<<TWINT) | (1<<TWSTO) | (1<<TWEN);			//清空TWINT，发送STOP信号，启动发送
}

